## conf/layer.conf
```bitbake
# We have a conf and classes directory, add to BBPATH
BBPATH .= ":${LAYERDIR}"

# We have recipes-* directories, add to BBFILES
BBFILES += "${LAYERDIR}/recipes-*/*/*.bb \
            ${LAYERDIR}/recipes-*/*/*.bbappend"

BBFILE_COLLECTIONS += "meta-xeno"
BBFILE_PATTERN_meta-xeno = "^${LAYERDIR}/"
BBFILE_PRIORITY_meta-xeno = "6"

LAYERDEPENDS_meta-xeno = "core"
LAYERSERIES_COMPAT_meta-xeno = "thud"
```
